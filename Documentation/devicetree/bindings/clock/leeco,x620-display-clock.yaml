## Documentation/devicetree/bindings/clock/leeco,x620-display-clock.yaml
```yaml
# SPDX-License-Identifier: (GPL-2.0-only OR BSD-2-Clause)
%YAML 1.2
---
$id: http://devicetree.org/schemas/clock/leeco,x620-display-clock.yaml#
$schema: http://devicetree.org/meta-schemas/core.yaml#

title: LeEco X620 retained MM clock parent

maintainers:
  - dysorder <dysorder@users.noreply.github.com>

description: |
  Temporary bring-up provider for firmware's existing MM source. The driver
  reads CLK_CFG_0 and the selected IMGPLL, UNIVPLL or MAINPLL rate without
  changing muxes or PLLs. Native MT6797 MMSYS gates and MIPI TX control the
  downstream display clocks. This provider replaces the global top clock
  driver during X620 bring-up; the two must not be enabled simultaneously.

properties:
  compatible:
    const: leeco,x620-display-clock
  "#clock-cells":
    const: 0
  mediatek,topckgen:
    $ref: /schemas/types.yaml#/definitions/phandle
    description: MT6797 TOPCKGEN syscon.
  mediatek,apmixedsys:
    $ref: /schemas/types.yaml#/definitions/phandle
    description: MT6797 APMIXED syscon.

required:
  - compatible
  - "#clock-cells"
  - mediatek,topckgen
  - mediatek,apmixedsys

additionalProperties: false
```

## Documentation/devicetree/bindings/clock/leeco,x620-msdc0-clocks.yaml
```yaml
# SPDX-License-Identifier: (GPL-2.0-only OR BSD-2-Clause)
%YAML 1.2
---
$id: http://devicetree.org/schemas/clock/leeco,x620-msdc0-clocks.yaml#
$schema: http://devicetree.org/meta-schemas/core.yaml#

title: LeEco X620 isolated MSDC0 bring-up clocks

maintainers:
  - dysorder <dysorder@users.noreply.github.com>

description: |
  Temporary controller-specific provider. It selects the 26 MHz oscillator
  for MSDC0 source and HCLK, controls the MSDC0 INFRA gate and source gate,
  and leaves other clock muxes and PLLs untouched. The optional high-speed
  profile configures only MSDCPLL to 400 MHz and selects firmware MAINPLL/4
  for HCLK. Clock indices are 0 (source), 1 (HCLK) and 2 (source gate).

properties:
  compatible:
    const: leeco,x620-msdc0-clocks

  "#clock-cells":
    const: 1

  mediatek,topckgen:
    $ref: /schemas/types.yaml#/definitions/phandle
    description: MT6797 top clock syscon containing CLK_CFG_7.

  mediatek,infracfg:
    $ref: /schemas/types.yaml#/definitions/phandle
    description: MT6797 INFRA syscon containing the MSDC0 clock gate.

  mediatek,apmixedsys:
    $ref: /schemas/types.yaml#/definitions/phandle
    description: MT6797 APMIXED syscon containing MSDCPLL and MAINPLL.

  mediatek,high-speed:
    type: boolean
    description: Use MSDCPLL and firmware MAINPLL/4 instead of the oscillator.

allOf:
  - if:
      required:
        - mediatek,high-speed
    then:
      required:
        - mediatek,apmixedsys

required:
  - compatible
  - "#clock-cells"
  - mediatek,topckgen
  - mediatek,infracfg

additionalProperties: false
```

## Documentation/devicetree/bindings/display/panel/leeco,x620-378c81.yaml
```yaml
# SPDX-License-Identifier: (GPL-2.0-only OR BSD-2-Clause)
%YAML 1.2
---
$id: http://devicetree.org/schemas/display/panel/leeco,x620-378c81.yaml#
$schema: http://devicetree.org/meta-schemas/core.yaml#

title: LeEco X620 378C81 command-mode panel

maintainers:
  - dysorder <dysorder@users.noreply.github.com>

description: |
  1080x1920 four-lane DSI panel identified as 378C81 by the stock X620 LK.
  The reset signal is controlled by bit 0 of MMSYS LCM_RST_B at offset 0x150.
  Initial bias-rail and external backlight power configuration is retained
  from firmware. The driver performs panel reset and DSI initialization.

allOf:
  - $ref: panel-common.yaml#

properties:
  compatible:
    const: leeco,x620-378c81
  reg:
    maxItems: 1
  mediatek,mmsys:
    $ref: /schemas/types.yaml#/definitions/phandle
    description: MMSYS syscon controlling the panel reset signal.
  port: true

required:
  - compatible
  - reg
  - mediatek,mmsys
  - port

unevaluatedProperties: false
```

## Documentation/devicetree/bindings/phy/leeco,x620-lk-usb-resources.yaml
```yaml
# SPDX-License-Identifier: (GPL-2.0-only OR BSD-2-Clause)
%YAML 1.2
---
$id: http://devicetree.org/schemas/phy/leeco,x620-lk-usb-resources.yaml#
$schema: http://devicetree.org/meta-schemas/core.yaml#

title: LeEco X620 USB2 resources retained from stock LK

maintainers:
  - dysorder <dysorder@users.noreply.github.com>

description: |
  Temporary MT6797 bring-up adapter for a USB2 PHY and three INFRA2 clock
  gates. Firmware supplies PLL, mux, PMIC and PHY calibration state.
  Clock indices are 0 (bus), 1 (system) and 2 (reference). The provider
  controls only gates and does not describe or change inherited rates.

properties:
  compatible:
    const: leeco,x620-lk-usb-resources

  reg:
    items:
      - description: USB PHY register bank, including the USB2 block at 0x800
      - description: INFRA clock-gate register bank

  reg-names:
    items:
      - const: phy
      - const: infracfg

  "#phy-cells":
    const: 0

  "#clock-cells":
    const: 1

required:
  - compatible
  - reg
  - reg-names
  - "#phy-cells"
  - "#clock-cells"

additionalProperties: false
```

## Documentation/devicetree/bindings/phy/mediatek,mt6797-lk-usb-resources.yaml
```yaml
# SPDX-License-Identifier: (GPL-2.0-only OR BSD-2-Clause)
%YAML 1.2
---
$id: http://devicetree.org/schemas/phy/mediatek,mt6797-lk-usb-resources.yaml#
$schema: http://devicetree.org/meta-schemas/core.yaml#

title: MediaTek MT6797 USB2 resources retained from stock LK

maintainers:
  - dysorder <dysorder@users.noreply.github.com>

description: |
  Temporary MT6797 bring-up adapter for a USB2 PHY and three INFRA2 clock
  gates. Firmware supplies PLL, mux, PMIC and PHY calibration state.
  Clock indices are 0 (bus), 1 (system) and 2 (reference). The provider
  controls only gates and does not describe or change inherited rates.

properties:
  compatible:
    oneOf:
      - const: mediatek,mt6797-lk-usb-resources
      - items:
          - const: mediatek,mt6797-lk-usb-resources
          - const: leeco,x620-lk-usb-resources
      - const: leeco,x620-lk-usb-resources
        deprecated: true

  reg:
    items:
      - description: USB PHY register bank, including the USB2 block at 0x800
      - description: INFRA clock-gate register bank

  reg-names:
    items:
      - const: phy
      - const: infracfg

  "#phy-cells":
    const: 0

  "#clock-cells":
    const: 1

required:
  - compatible
  - reg
  - reg-names
  - "#phy-cells"
  - "#clock-cells"

additionalProperties: false
```

## drivers/net/wireless/mediatek/mt6797/Kconfig
```kconfig
# SPDX-License-Identifier: GPL-2.0-only
config MT6797_WLAN
	tristate "MediaTek MT6797 integrated WLAN"
	depends on ARCH_MEDIATEK || COMPILE_TEST
	depends on CFG80211 && INET && MT6797_WMT_WIFI
	select FW_LOADER
	select WEXT_PRIV
	select WIRELESS_EXT
	select NL80211_TESTMODE
	help
	  MT6797 integrated WLAN using the vendor gen3 firmware interface
	  and the on-chip AHB HIF. Requires CONSYS power and WMT transport.
```
